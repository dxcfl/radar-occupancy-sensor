## sample.yaml
```yaml
sample:
  description: Matter Radar Occupancy Sensor sample based on the Matter Template sample
  name: Matter Radar Occupancy Sensor
tests:
  sample.matter.template.debug:
    build_only: true
    integration_platforms:
      - nrf5340dk_nrf5340_cpuapp
      - nrf7002dk_nrf5340_cpuapp
    platform_allow: nrf5340dk_nrf5340_cpuapp nrf7002dk_nrf5340_cpuapp
  sample.matter.template.release:
    build_only: true
    extra_args: CONF_FILE=prj_release.conf
    integration_platforms:
      - nrf5340dk_nrf5340_cpuapp
      - nrf7002dk_nrf5340_cpuapp
    platform_allow: nrf5340dk_nrf5340_cpuapp nrf7002dk_nrf5340_cpuapp
```
